## boards/arm/mec172x_azbeach/Kconfig.board
```kconfig
# Copyright (c) 2022, Silicom Connectivity Solutions
# SPDX-License-Identifier: Apache-2.0

config BOARD_MEC172X_AZBEACH
	bool "Silicom Arizona Beach MEC172X EC"
	depends on SOC_MEC172X_NSZ
```

## dts/bindings/gpio/microchip,xec-bgpo.yaml
```yaml
# Copyright (c) 2019, Intel Corporation
# SPDX-License-Identifier: Apache-2.0

description: Microchip CEC/MEC BGPO node

compatible: "microchip,xec-bgpo"

include: [gpio-controller.yaml, base.yaml]

properties:
    reg:
      required: true

    label:
      required: true

    "#gpio-cells":
      const: 2

gpio-cells:
  - pin
  - flags
```
